SECTIONS
{
    HIDDEN(__romPos = 0);
    header_ROM_START = __romPos;
    header_VRAM = ADDR(.header);
    .header : AT(header_ROM_START) SUBALIGN(16)
    {
        FILL(0x00000000);
        header_DATA_START = .;
        build/asm/header.s.o(.data);
        header_DATA_END = .;
        header_DATA_SIZE = ABSOLUTE(header_DATA_END - header_DATA_START);
    }
    __romPos += SIZEOF(.header);
    header_ROM_END = __romPos;
    header_VRAM_END = .;

    boot_ROM_START = __romPos;
    boot_VRAM = ADDR(.boot);
    .boot : AT(boot_ROM_START) SUBALIGN(16)
    {
        FILL(0x00000000);
        boot_DATA_START = .;
        build/assets/boot.bin.o(.data);
        boot_DATA_END = .;
        boot_DATA_SIZE = ABSOLUTE(boot_DATA_END - boot_DATA_START);
    }
    __romPos += SIZEOF(.boot);
    boot_ROM_END = __romPos;
    boot_VRAM_END = .;

    main_code_ROM_START = __romPos;
    main_code_VRAM = ADDR(.main_code);
    .main_code 0x80000400 : AT(main_code_ROM_START) SUBALIGN(16)
    {
        FILL(0x00000000);
        main_code_TEXT_START = .;
        build/src/1340.c.o(.text);
        build/src/22C0.c.o(.text);
        build/src/2820.c.o(.text);
        build/src/3CA0.c.o(.text);
        build/src/42E0.c.o(.text);
        build/src/5550.c.o(.text);
        build/src/63A0.c.o(.text);
        build/src/7210.c.o(.text);
        build/src/7490.c.o(.text);
        build/src/96E0.c.o(.text);
        build/src/A1F0.c.o(.text);
        build/src/ABC0.c.o(.text);
        build/src/C3B0.c.o(.text);
        build/src/CA60.c.o(.text);
        build/src/CFD0.c.o(.text);
        build/src/DC40.c.o(.text);
        build/src/F490.c.o(.text);
        build/src/11F60.c.o(.text);
        build/src/12110.c.o(.text);
        build/src/121E0.c.o(.text);
        build/src/12460.c.o(.text);
        build/src/14AE0.c.o(.text);
        build/src/14E80.c.o(.text);
        build/src/15100.c.o(.text);
        build/src/15350.c.o(.text);
        build/src/15F40.c.o(.text);
        build/src/163B0.c.o(.text);
        build/src/166E0.c.o(.text);
        build/src/17C10.c.o(.text);
        build/src/18080.c.o(.text);
        build/src/18AD0.c.o(.text);
        build/src/18D00.c.o(.text);
        build/src/1ABE0.c.o(.text);
        build/src/1C710.c.o(.text);
        build/src/1E120.c.o(.text);
        build/src/1E3E0.c.o(.text);
        build/src/1EF70.c.o(.text);
        build/src/1F260.c.o(.text);
        build/src/1F7B0.c.o(.text);
        build/src/1F970.c.o(.text);
        build/src/20260.c.o(.text);
        build/src/20990.c.o(.text);
        build/src/20D10.c.o(.text);
        build/src/20FE0.c.o(.text);
        build/src/21010.c.o(.text);
        build/src/21370.c.o(.text);
        build/src/213E0.c.o(.text);
        build/src/215A0.c.o(.text);
        build/src/21610.c.o(.text);
        build/src/216C0.c.o(.text);
        build/src/219F0.c.o(.text);
        build/src/21E20.c.o(.text);
        build/src/21FD0.c.o(.text);
        build/src/22540.c.o(.text);
        build/src/23030.c.o(.text);
        build/src/23160.c.o(.text);
        build/src/231D0.c.o(.text);
        build/src/23310.c.o(.text);
        build/src/23450.c.o(.text);
        build/src/23590.c.o(.text);
        build/src/23610.c.o(.text);
        build/src/236C0.c.o(.text);
        build/src/23740.c.o(.text);
        build/src/23850.c.o(.text);
        build/src/238C0.c.o(.text);
        build/src/23B40.c.o(.text);
        build/src/23B70.c.o(.text);
        build/src/23E30.c.o(.text);
        build/src/23EE0.c.o(.text);
        build/src/23F70.c.o(.text);
        build/src/24240.c.o(.text);
        build/src/24400.c.o(.text);
        build/src/24540.c.o(.text);
        build/src/245F0.c.o(.text);
        build/src/24600.c.o(.text);
        build/src/24F50.c.o(.text);
        build/src/25040.c.o(.text);
        build/src/250D0.c.o(.text);
        build/src/25170.c.o(.text);
        build/src/25200.c.o(.text);
        build/src/25280.c.o(.text);
        build/src/25420.c.o(.text);
        build/src/25680.c.o(.text);
        build/src/25730.c.o(.text);
        build/src/25940.c.o(.text);
        build/src/25960.c.o(.text);
        build/src/25A10.c.o(.text);
        build/src/262E0.c.o(.text);
        build/src/26380.c.o(.text);
        build/src/26420.c.o(.text);
        build/src/26460.c.o(.text);
        build/src/26580.c.o(.text);
        build/src/268C0.c.o(.text);
        build/src/26DF0.c.o(.text);
        build/src/26E00.c.o(.text);
        build/src/27160.c.o(.text);
        build/src/27170.c.o(.text);
        build/src/290F0.c.o(.text);
        build/src/29290.c.o(.text);
        build/src/29620.c.o(.text);
        build/src/29F80.c.o(.text);
        build/src/29F90.c.o(.text);
        build/src/29FA0.c.o(.text);
        build/src/2A2F0.c.o(.text);
        build/src/2A380.c.o(.text);
        build/src/2A3B0.c.o(.text);
        build/src/2B540.c.o(.text);
        build/src/2B5E0.c.o(.text);
        build/src/2B5F0.c.o(.text);
        build/src/2B6B0.c.o(.text);
        build/src/2BF00.c.o(.text);
        build/src/2CBA0.c.o(.text);
        build/src/2CEA0.c.o(.text);
        build/src/2DB00.c.o(.text);
        build/src/2DC10.c.o(.text);
        build/src/2DD60.c.o(.text);
        build/src/2E1E0.c.o(.text);
        build/src/2E310.c.o(.text);
        build/src/2E410.c.o(.text);
        build/src/2E420.c.o(.text);
        build/src/2F690.c.o(.text);
        build/src/302A0.c.o(.text);
        build/src/30320.c.o(.text);
        build/src/30330.c.o(.text);
        build/src/30390.c.o(.text);
        build/src/31990.c.o(.text);
        build/src/40C00.c.o(.text);
        build/src/12DB80.c.o(.text);
        build/src/12EAA0.c.o(.text);
        build/src/12F270.c.o(.text);
        build/src/12FF20.c.o(.text);
        build/src/13FB80.c.o(.text);
        build/src/13FF80.c.o(.text);
        build/src/140C00.c.o(.text);
        build/src/1C0D50.c.o(.text);
        build/src/345440.c.o(.text);
        build/src/74EB40.c.o(.text);
        build/src/74EBB0.c.o(.text);
        build/src/74F340.c.o(.text);
        build/src/74F520.c.o(.text);
        build/src/750640.c.o(.text);
        build/src/750D20.c.o(.text);
        build/src/751140.c.o(.text);
        build/src/7512D0.c.o(.text);
        build/src/751480.c.o(.text);
        build/src/751770.c.o(.text);
        build/src/751990.c.o(.text);
        build/src/751B60.c.o(.text);
        build/src/751E30.c.o(.text);
        build/src/752870.c.o(.text);
        build/src/752890.c.o(.text);
        build/src/752A50.c.o(.text);
        build/src/753460.c.o(.text);
        build/src/7568E0.c.o(.text);
        build/src/756B20.c.o(.text);
        build/src/756CE0.c.o(.text);
        build/src/7571F0.c.o(.text);
        build/src/7573B0.c.o(.text);
        build/src/757480.c.o(.text);
        build/src/7577F0.c.o(.text);
        build/src/757A20.c.o(.text);
        build/src/757AA0.c.o(.text);
        build/src/759480.c.o(.text);
        build/src/759D20.c.o(.text);
        build/src/759F90.c.o(.text);
        build/src/75A160.c.o(.text);
        build/src/75A6D0.c.o(.text);
        build/src/75A760.c.o(.text);
        build/src/75A870.c.o(.text);
        build/src/75B060.c.o(.text);
        build/src/75B1D0.c.o(.text);
        build/src/75B450.c.o(.text);
        build/src/75B8E0.c.o(.text);
        build/src/76DBA0.c.o(.text);
        build/src/778840.c.o(.text);
        build/src/780C30.c.o(.text);
        build/src/784030.c.o(.text);
        build/src/784C30.c.o(.text);
        build/src/785FD0.c.o(.text);
        build/src/786C30.c.o(.text);
        build/src/788870.c.o(.text);
        build/src/788940.c.o(.text);
        build/src/78C500.c.o(.text);
        build/src/78CC30.c.o(.text);
        build/src/7BD440.c.o(.text);
        build/src/7BD500.c.o(.text);
        build/src/7BE410.c.o(.text);
        build/src/7C0770.c.o(.text);
        build/src/7C0C00.c.o(.text);
        build/src/7C0C30.c.o(.text);
        build/src/7C0C80.c.o(.text);
        build/src/7C1040.c.o(.text);
        build/src/7C1090.c.o(.text);
        build/src/7C2C00.c.o(.text);
        build/src/7C3030.c.o(.text);
        build/src/7C3C50.c.o(.text);
        build/src/7C6C30.c.o(.text);
        build/src/7C8850.c.o(.text);
        build/src/7C9000.c.o(.text);
        build/src/7C9C40.c.o(.text);
        build/src/7D03F0.c.o(.text);
        build/src/7D2C30.c.o(.text);
        build/src/7D9A10.c.o(.text);
        build/src/7E2850.c.o(.text);
        build/src/7F40B0.c.o(.text);
        build/src/7F8740.c.o(.text);
        . = ALIGN(., 16);
        main_code_TEXT_END = .;
        main_code_TEXT_SIZE = ABSOLUTE(main_code_TEXT_END - main_code_TEXT_START);
        main_code_DATA_START = .;
        build/assets/1000.bin.o(.data);
        build/assets/30520.bin.o(.data);
        build/assets/319F0.bin.o(.data);
        build/assets/35630.bin.o(.data);
        build/assets/35920.bin.o(.data);
        build/assets/3D4B0.bin.o(.data);
        build/assets/4C000.bin.o(.data);
        build/assets/A6700.bin.o(.data);
        build/assets/AF2C0.bin.o(.data);
        build/assets/C0C00.bin.o(.data);
        build/assets/CA500.bin.o(.data);
        build/assets/D8560.bin.o(.data);
        build/assets/E1C00.bin.o(.data);
        build/assets/E6A40.bin.o(.data);
        build/assets/106070.bin.o(.data);
        build/assets/106D90.bin.o(.data);
        build/assets/107400.bin.o(.data);
        build/assets/10A820.bin.o(.data);
        build/assets/10B230.bin.o(.data);
        build/assets/10CBD0.bin.o(.data);
        build/assets/10CE60.bin.o(.data);
        build/assets/10D600.bin.o(.data);
        build/assets/10D630.bin.o(.data);
        build/assets/10F090.bin.o(.data);
        build/assets/111550.bin.o(.data);
        build/assets/112F70.bin.o(.data);
        build/assets/115120.bin.o(.data);
        build/assets/116190.bin.o(.data);
        build/assets/116300.bin.o(.data);
        build/assets/116330.bin.o(.data);
        build/assets/117810.bin.o(.data);
        build/assets/117C90.bin.o(.data);
        build/assets/117D10.bin.o(.data);
        build/assets/117E50.bin.o(.data);
        build/assets/117F70.bin.o(.data);
        build/assets/119F90.bin.o(.data);
        build/assets/11A260.bin.o(.data);
        build/assets/11A4C0.bin.o(.data);
        build/assets/11A7E0.bin.o(.data);
        build/assets/11AE20.bin.o(.data);
        build/assets/11C1B0.bin.o(.data);
        build/assets/11DD20.bin.o(.data);
        build/assets/11DE00.bin.o(.data);
        build/assets/11E5A0.bin.o(.data);
        build/assets/11E650.bin.o(.data);
        build/assets/11E850.bin.o(.data);
        build/assets/11EE60.bin.o(.data);
        build/assets/11F7E0.bin.o(.data);
        build/assets/11FAA0.bin.o(.data);
        build/assets/11FBA0.bin.o(.data);
        build/assets/120270.bin.o(.data);
        build/assets/120380.bin.o(.data);
        build/assets/1207C0.bin.o(.data);
        build/assets/1212C0.bin.o(.data);
        build/assets/121E50.bin.o(.data);
        build/assets/125020.bin.o(.data);
        build/assets/1255C0.bin.o(.data);
        build/assets/125C50.bin.o(.data);
        build/assets/126E30.bin.o(.data);
        build/assets/12DF10.bin.o(.data);
        build/assets/12E1A0.bin.o(.data);
        build/assets/12E4A0.bin.o(.data);
        build/assets/12EB80.bin.o(.data);
        build/assets/12F290.bin.o(.data);
        build/assets/12FF30.bin.o(.data);
        build/assets/12FF90.bin.o(.data);
        build/assets/141400.bin.o(.data);
        build/assets/145DB0.bin.o(.data);
        build/assets/146C30.bin.o(.data);
        build/assets/14D890.bin.o(.data);
        build/assets/157650.bin.o(.data);
        build/assets/181C10.bin.o(.data);
        build/assets/181C30.bin.o(.data);
        build/assets/182000.bin.o(.data);
        build/assets/183020.bin.o(.data);
        build/assets/186A60.bin.o(.data);
        build/assets/18A7F0.bin.o(.data);
        build/assets/18B9A0.bin.o(.data);
        build/assets/1903F0.bin.o(.data);
        build/assets/191E30.bin.o(.data);
        build/assets/193AE0.bin.o(.data);
        build/assets/19A580.bin.o(.data);
        build/assets/19B930.bin.o(.data);
        build/assets/19F190.bin.o(.data);
        build/assets/1A0EF0.bin.o(.data);
        build/assets/1A3100.bin.o(.data);
        build/assets/1AAE70.bin.o(.data);
        build/assets/1B58C0.bin.o(.data);
        build/assets/1B8840.bin.o(.data);
        build/assets/1C0940.bin.o(.data);
        build/assets/1C0C00.bin.o(.data);
        build/assets/1C0C40.bin.o(.data);
        build/assets/1C0DC0.bin.o(.data);
        build/assets/1C1460.bin.o(.data);
        build/assets/1C3010.bin.o(.data);
        build/assets/1C3020.bin.o(.data);
        build/assets/1C30C0.bin.o(.data);
        build/assets/1C3430.bin.o(.data);
        build/assets/1C48F0.bin.o(.data);
        build/assets/1C55E0.bin.o(.data);
        build/assets/1C7380.bin.o(.data);
        build/assets/1C8670.bin.o(.data);
        build/assets/1C94B0.bin.o(.data);
        build/assets/1CA220.bin.o(.data);
        build/assets/1CAE00.bin.o(.data);
        build/assets/1E1BD0.bin.o(.data);
        build/assets/246860.bin.o(.data);
        build/assets/246C30.bin.o(.data);
        build/assets/24D4C0.bin.o(.data);
        build/assets/24E070.bin.o(.data);
        build/assets/26D200.bin.o(.data);
        build/assets/2CD3D0.bin.o(.data);
        build/assets/2E4A00.bin.o(.data);
        build/assets/2E4B70.bin.o(.data);
        build/assets/3036D0.bin.o(.data);
        build/assets/303810.bin.o(.data);
        build/assets/304700.bin.o(.data);
        build/assets/330560.bin.o(.data);
        build/assets/343C20.bin.o(.data);
        build/assets/344040.bin.o(.data);
        build/assets/345040.bin.o(.data);
        build/assets/345460.bin.o(.data);
        build/assets/345C50.bin.o(.data);
        build/assets/3589D0.bin.o(.data);
        build/assets/35DE20.bin.o(.data);
        build/assets/375010.bin.o(.data);
        build/assets/385310.bin.o(.data);
        build/assets/385C00.bin.o(.data);
        build/assets/3DF1B0.bin.o(.data);
        build/assets/438040.bin.o(.data);
        build/assets/440C10.bin.o(.data);
        build/assets/446330.bin.o(.data);
        build/assets/44D740.bin.o(.data);
        build/assets/451360.bin.o(.data);
        build/assets/474B00.bin.o(.data);
        build/assets/49C760.bin.o(.data);
        build/assets/4A7F80.bin.o(.data);
        build/assets/4F3380.bin.o(.data);
        build/assets/5058C0.bin.o(.data);
        build/assets/506860.bin.o(.data);
        build/assets/5417C0.bin.o(.data);
        build/assets/547C80.bin.o(.data);
        build/assets/5494E0.bin.o(.data);
        build/assets/54B640.bin.o(.data);
        build/assets/575AA0.bin.o(.data);
        build/assets/57CBF0.bin.o(.data);
        build/assets/586830.bin.o(.data);
        build/assets/586850.bin.o(.data);
        build/assets/5C0C00.bin.o(.data);
        build/assets/5C0C30.bin.o(.data);
        build/assets/5C3010.bin.o(.data);
        build/assets/5C6830.bin.o(.data);
        build/assets/5C9280.bin.o(.data);
        build/assets/5CC860.bin.o(.data);
        build/src/1340.c.o(.data);
        build/src/22C0.c.o(.data);
        build/src/2820.c.o(.data);
        build/src/3CA0.c.o(.data);
        build/src/42E0.c.o(.data);
        build/src/5550.c.o(.data);
        build/src/63A0.c.o(.data);
        build/src/7210.c.o(.data);
        build/src/7490.c.o(.data);
        build/src/96E0.c.o(.data);
        build/src/A1F0.c.o(.data);
        build/src/ABC0.c.o(.data);
        build/src/C3B0.c.o(.data);
        build/src/CA60.c.o(.data);
        build/src/CFD0.c.o(.data);
        build/src/DC40.c.o(.data);
        build/src/F490.c.o(.data);
        build/src/11F60.c.o(.data);
        build/src/12110.c.o(.data);
        build/src/121E0.c.o(.data);
        build/src/12460.c.o(.data);
        build/src/14AE0.c.o(.data);
        build/src/14E80.c.o(.data);
        build/src/15100.c.o(.data);
        build/src/15350.c.o(.data);
        build/src/15F40.c.o(.data);
        build/src/163B0.c.o(.data);
        build/src/166E0.c.o(.data);
        build/src/17C10.c.o(.data);
        build/src/18080.c.o(.data);
        build/src/18AD0.c.o(.data);
        build/src/18D00.c.o(.data);
        build/src/1ABE0.c.o(.data);
        build/src/1C710.c.o(.data);
        build/src/1E120.c.o(.data);
        build/src/1E3E0.c.o(.data);
        build/src/1EF70.c.o(.data);
        build/src/1F260.c.o(.data);
        build/src/1F7B0.c.o(.data);
        build/src/1F970.c.o(.data);
        build/src/20260.c.o(.data);
        build/src/20990.c.o(.data);
        build/src/20D10.c.o(.data);
        build/src/20FE0.c.o(.data);
        build/src/21010.c.o(.data);
        build/src/21370.c.o(.data);
        build/src/213E0.c.o(.data);
        build/src/215A0.c.o(.data);
        build/src/21610.c.o(.data);
        build/src/216C0.c.o(.data);
        build/src/219F0.c.o(.data);
        build/src/21E20.c.o(.data);
        build/src/21FD0.c.o(.data);
        build/src/22540.c.o(.data);
        build/src/23030.c.o(.data);
        build/src/23160.c.o(.data);
        build/src/231D0.c.o(.data);
        build/src/23310.c.o(.data);
        build/src/23450.c.o(.data);
        build/src/23590.c.o(.data);
        build/src/23610.c.o(.data);
        build/src/236C0.c.o(.data);
        build/src/23740.c.o(.data);
        build/src/23850.c.o(.data);
        build/src/238C0.c.o(.data);
        build/src/23B40.c.o(.data);
        build/src/23B70.c.o(.data);
        build/src/23E30.c.o(.data);
        build/src/23EE0.c.o(.data);
        build/src/23F70.c.o(.data);
        build/src/24240.c.o(.data);
        build/src/24400.c.o(.data);
        build/src/24540.c.o(.data);
        build/src/245F0.c.o(.data);
        build/src/24600.c.o(.data);
        build/src/24F50.c.o(.data);
        build/src/25040.c.o(.data);
        build/src/250D0.c.o(.data);
        build/src/25170.c.o(.data);
        build/src/25200.c.o(.data);
        build/src/25280.c.o(.data);
        build/src/25420.c.o(.data);
        build/src/25680.c.o(.data);
        build/src/25730.c.o(.data);
        build/src/25940.c.o(.data);
        build/src/25960.c.o(.data);
        build/src/25A10.c.o(.data);
        build/src/262E0.c.o(.data);
        build/src/26380.c.o(.data);
        build/src/26420.c.o(.data);
        build/src/26460.c.o(.data);
        build/src/26580.c.o(.data);
        build/src/268C0.c.o(.data);
        build/src/26DF0.c.o(.data);
        build/src/26E00.c.o(.data);
        build/src/27160.c.o(.data);
        build/src/27170.c.o(.data);
        build/src/290F0.c.o(.data);
        build/src/29290.c.o(.data);
        build/src/29620.c.o(.data);
        build/src/29F80.c.o(.data);
        build/src/29F90.c.o(.data);
        build/src/29FA0.c.o(.data);
        build/src/2A2F0.c.o(.data);
        build/src/2A380.c.o(.data);
        build/src/2A3B0.c.o(.data);
        build/src/2B540.c.o(.data);
        build/src/2B5E0.c.o(.data);
        build/src/2B5F0.c.o(.data);
        build/src/2B6B0.c.o(.data);
        build/src/2BF00.c.o(.data);
        build/src/2CBA0.c.o(.data);
        build/src/2CEA0.c.o(.data);
        build/src/2DB00.c.o(.data);
        build/src/2DC10.c.o(.data);
        build/src/2DD60.c.o(.data);
        build/src/2E1E0.c.o(.data);
        build/src/2E310.c.o(.data);
        build/src/2E410.c.o(.data);
        build/src/2E420.c.o(.data);
        build/src/2F690.c.o(.data);
        build/src/302A0.c.o(.data);
        build/src/30320.c.o(.data);
        build/src/30330.c.o(.data);
        build/src/30390.c.o(.data);
        build/src/31990.c.o(.data);
        build/src/40C00.c.o(.data);
        build/src/12DB80.c.o(.data);
        build/src/12EAA0.c.o(.data);
        build/src/12F270.c.o(.data);
        build/src/12FF20.c.o(.data);
        build/src/13FB80.c.o(.data);
        build/src/13FF80.c.o(.data);
        build/src/140C00.c.o(.data);
        build/src/1C0D50.c.o(.data);
        build/src/345440.c.o(.data);
        build/src/74EB40.c.o(.data);
        build/src/74EBB0.c.o(.data);
        build/src/74F340.c.o(.data);
        build/src/74F520.c.o(.data);
        build/src/750640.c.o(.data);
        build/src/750D20.c.o(.data);
        build/src/751140.c.o(.data);
        build/src/7512D0.c.o(.data);
        build/src/751480.c.o(.data);
        build/src/751770.c.o(.data);
        build/src/751990.c.o(.data);
        build/src/751B60.c.o(.data);
        build/src/751E30.c.o(.data);
        build/src/752870.c.o(.data);
        build/src/752890.c.o(.data);
        build/src/752A50.c.o(.data);
        build/src/753460.c.o(.data);
        build/src/7568E0.c.o(.data);
        build/src/756B20.c.o(.data);
        build/src/756CE0.c.o(.data);
        build/src/7571F0.c.o(.data);
        build/src/7573B0.c.o(.data);
        build/src/757480.c.o(.data);
        build/src/7577F0.c.o(.data);
        build/src/757A20.c.o(.data);
        build/src/757AA0.c.o(.data);
        build/src/759480.c.o(.data);
        build/src/759D20.c.o(.data);
        build/src/759F90.c.o(.data);
        build/src/75A160.c.o(.data);
        build/src/75A6D0.c.o(.data);
        build/src/75A760.c.o(.data);
        build/src/75A870.c.o(.data);
        build/src/75B060.c.o(.data);
        build/src/75B1D0.c.o(.data);
        build/src/75B450.c.o(.data);
        build/src/75B8E0.c.o(.data);
        build/src/76DBA0.c.o(.data);
        build/src/778840.c.o(.data);
        build/src/780C30.c.o(.data);
        build/src/784030.c.o(.data);
        build/src/784C30.c.o(.data);
        build/src/785FD0.c.o(.data);
        build/src/786C30.c.o(.data);
        build/src/788870.c.o(.data);
        build/src/788940.c.o(.data);
        build/src/78C500.c.o(.data);
        build/src/78CC30.c.o(.data);
        build/src/7BD440.c.o(.data);
        build/src/7BD500.c.o(.data);
        build/src/7BE410.c.o(.data);
        build/src/7C0770.c.o(.data);
        build/src/7C0C00.c.o(.data);
        build/src/7C0C30.c.o(.data);
        build/src/7C0C80.c.o(.data);
        build/src/7C1040.c.o(.data);
        build/src/7C1090.c.o(.data);
        build/src/7C2C00.c.o(.data);
        build/src/7C3030.c.o(.data);
        build/src/7C3C50.c.o(.data);
        build/src/7C6C30.c.o(.data);
        build/src/7C8850.c.o(.data);
        build/src/7C9000.c.o(.data);
        build/src/7C9C40.c.o(.data);
        build/src/7D03F0.c.o(.data);
        build/src/7D2C30.c.o(.data);
        build/src/7D9A10.c.o(.data);
        build/src/7E2850.c.o(.data);
        build/src/7F40B0.c.o(.data);
        build/src/7F8740.c.o(.data);
        . = ALIGN(., 16);
        main_code_DATA_END = .;
        main_code_DATA_SIZE = ABSOLUTE(main_code_DATA_END - main_code_DATA_START);
        main_code_RODATA_START = .;
        build/src/1340.c.o(.rodata);
        build/src/22C0.c.o(.rodata);
        build/src/2820.c.o(.rodata);
        build/src/3CA0.c.o(.rodata);
        build/src/42E0.c.o(.rodata);
        build/src/5550.c.o(.rodata);
        build/src/63A0.c.o(.rodata);
        build/src/7210.c.o(.rodata);
        build/src/7490.c.o(.rodata);
        build/src/96E0.c.o(.rodata);
        build/src/A1F0.c.o(.rodata);
        build/src/ABC0.c.o(.rodata);
        build/src/C3B0.c.o(.rodata);
        build/src/CA60.c.o(.rodata);
        build/src/CFD0.c.o(.rodata);
        build/src/DC40.c.o(.rodata);
        build/src/F490.c.o(.rodata);
        build/src/11F60.c.o(.rodata);
        build/src/12110.c.o(.rodata);
        build/src/121E0.c.o(.rodata);
        build/src/12460.c.o(.rodata);
        build/src/14AE0.c.o(.rodata);
        build/src/14E80.c.o(.rodata);
        build/src/15100.c.o(.rodata);
        build/src/15350.c.o(.rodata);
        build/src/15F40.c.o(.rodata);
        build/src/163B0.c.o(.rodata);
        build/src/166E0.c.o(.rodata);
        build/src/17C10.c.o(.rodata);
        build/src/18080.c.o(.rodata);
        build/src/18AD0.c.o(.rodata);
        build/src/18D00.c.o(.rodata);
        build/src/1ABE0.c.o(.rodata);
        build/src/1C710.c.o(.rodata);
        build/src/1E120.c.o(.rodata);
        build/src/1E3E0.c.o(.rodata);
        build/src/1EF70.c.o(.rodata);
        build/src/1F260.c.o(.rodata);
        build/src/1F7B0.c.o(.rodata);
        build/src/1F970.c.o(.rodata);
        build/src/20260.c.o(.rodata);
        build/src/20990.c.o(.rodata);
        build/src/20D10.c.o(.rodata);
        build/src/20FE0.c.o(.rodata);
        build/src/21010.c.o(.rodata);
        build/src/21370.c.o(.rodata);
        build/src/213E0.c.o(.rodata);
        build/src/215A0.c.o(.rodata);
        build/src/21610.c.o(.rodata);
        build/src/216C0.c.o(.rodata);
        build/src/219F0.c.o(.rodata);
        build/src/21E20.c.o(.rodata);
        build/src/21FD0.c.o(.rodata);
        build/src/22540.c.o(.rodata);
        build/src/23030.c.o(.rodata);
        build/src/23160.c.o(.rodata);
        build/src/231D0.c.o(.rodata);
        build/src/23310.c.o(.rodata);
        build/src/23450.c.o(.rodata);
        build/src/23590.c.o(.rodata);
        build/src/23610.c.o(.rodata);
        build/src/236C0.c.o(.rodata);
        build/src/23740.c.o(.rodata);
        build/src/23850.c.o(.rodata);
        build/src/238C0.c.o(.rodata);
        build/src/23B40.c.o(.rodata);
        build/src/23B70.c.o(.rodata);
        build/src/23E30.c.o(.rodata);
        build/src/23EE0.c.o(.rodata);
        build/src/23F70.c.o(.rodata);
        build/src/24240.c.o(.rodata);
        build/src/24400.c.o(.rodata);
        build/src/24540.c.o(.rodata);
        build/src/245F0.c.o(.rodata);
        build/src/24600.c.o(.rodata);
        build/src/24F50.c.o(.rodata);
        build/src/25040.c.o(.rodata);
        build/src/250D0.c.o(.rodata);
        build/src/25170.c.o(.rodata);
        build/src/25200.c.o(.rodata);
        build/src/25280.c.o(.rodata);
        build/src/25420.c.o(.rodata);
        build/src/25680.c.o(.rodata);
        build/src/25730.c.o(.rodata);
        build/src/25940.c.o(.rodata);
        build/src/25960.c.o(.rodata);
        build/src/25A10.c.o(.rodata);
        build/src/262E0.c.o(.rodata);
        build/src/26380.c.o(.rodata);
        build/src/26420.c.o(.rodata);
        build/src/26460.c.o(.rodata);
        build/src/26580.c.o(.rodata);
        build/src/268C0.c.o(.rodata);
        build/src/26DF0.c.o(.rodata);
        build/src/26E00.c.o(.rodata);
        build/src/27160.c.o(.rodata);
        build/src/27170.c.o(.rodata);
        build/src/290F0.c.o(.rodata);
        build/src/29290.c.o(.rodata);
        build/src/29620.c.o(.rodata);
        build/src/29F80.c.o(.rodata);
        build/src/29F90.c.o(.rodata);
        build/src/29FA0.c.o(.rodata);
        build/src/2A2F0.c.o(.rodata);
        build/src/2A380.c.o(.rodata);
        build/src/2A3B0.c.o(.rodata);
        build/src/2B540.c.o(.rodata);
        build/src/2B5E0.c.o(.rodata);
        build/src/2B5F0.c.o(.rodata);
        build/src/2B6B0.c.o(.rodata);
        build/src/2BF00.c.o(.rodata);
        build/src/2CBA0.c.o(.rodata);
        build/src/2CEA0.c.o(.rodata);
        build/src/2DB00.c.o(.rodata);
        build/src/2DC10.c.o(.rodata);
        build/src/2DD60.c.o(.rodata);
        build/src/2E1E0.c.o(.rodata);
        build/src/2E310.c.o(.rodata);
        build/src/2E410.c.o(.rodata);
        build/src/2E420.c.o(.rodata);
        build/src/2F690.c.o(.rodata);
        build/src/302A0.c.o(.rodata);
        build/src/30320.c.o(.rodata);
        build/src/30330.c.o(.rodata);
        build/src/30390.c.o(.rodata);
        build/src/31990.c.o(.rodata);
        build/src/40C00.c.o(.rodata);
        build/src/12DB80.c.o(.rodata);
        build/src/12EAA0.c.o(.rodata);
        build/src/12F270.c.o(.rodata);
        build/src/12FF20.c.o(.rodata);
        build/src/13FB80.c.o(.rodata);
        build/src/13FF80.c.o(.rodata);
        build/src/140C00.c.o(.rodata);
        build/src/1C0D50.c.o(.rodata);
        build/src/345440.c.o(.rodata);
        build/src/74EB40.c.o(.rodata);
        build/src/74EBB0.c.o(.rodata);
        build/src/74F340.c.o(.rodata);
        build/src/74F520.c.o(.rodata);
        build/src/750640.c.o(.rodata);
        build/src/750D20.c.o(.rodata);
        build/src/751140.c.o(.rodata);
        build/src/7512D0.c.o(.rodata);
        build/src/751480.c.o(.rodata);
        build/src/751770.c.o(.rodata);
        build/src/751990.c.o(.rodata);
        build/src/751B60.c.o(.rodata);
        build/src/751E30.c.o(.rodata);
        build/src/752870.c.o(.rodata);
        build/src/752890.c.o(.rodata);
        build/src/752A50.c.o(.rodata);
        build/src/753460.c.o(.rodata);
        build/src/7568E0.c.o(.rodata);
        build/src/756B20.c.o(.rodata);
        build/src/756CE0.c.o(.rodata);
        build/src/7571F0.c.o(.rodata);
        build/src/7573B0.c.o(.rodata);
        build/src/757480.c.o(.rodata);
        build/src/7577F0.c.o(.rodata);
        build/src/757A20.c.o(.rodata);
        build/src/757AA0.c.o(.rodata);
        build/src/759480.c.o(.rodata);
        build/src/759D20.c.o(.rodata);
        build/src/759F90.c.o(.rodata);
        build/src/75A160.c.o(.rodata);
        build/src/75A6D0.c.o(.rodata);
        build/src/75A760.c.o(.rodata);
        build/src/75A870.c.o(.rodata);
        build/src/75B060.c.o(.rodata);
        build/src/75B1D0.c.o(.rodata);
        build/src/75B450.c.o(.rodata);
        build/src/75B8E0.c.o(.rodata);
        build/src/76DBA0.c.o(.rodata);
        build/src/778840.c.o(.rodata);
        build/src/780C30.c.o(.rodata);
        build/src/784030.c.o(.rodata);
        build/src/784C30.c.o(.rodata);
        build/src/785FD0.c.o(.rodata);
        build/src/786C30.c.o(.rodata);
        build/src/788870.c.o(.rodata);
        build/src/788940.c.o(.rodata);
        build/src/78C500.c.o(.rodata);
        build/src/78CC30.c.o(.rodata);
        build/src/7BD440.c.o(.rodata);
        build/src/7BD500.c.o(.rodata);
        build/src/7BE410.c.o(.rodata);
        build/src/7C0770.c.o(.rodata);
        build/src/7C0C00.c.o(.rodata);
        build/src/7C0C30.c.o(.rodata);
        build/src/7C0C80.c.o(.rodata);
        build/src/7C1040.c.o(.rodata);
        build/src/7C1090.c.o(.rodata);
        build/src/7C2C00.c.o(.rodata);
        build/src/7C3030.c.o(.rodata);
        build/src/7C3C50.c.o(.rodata);
        build/src/7C6C30.c.o(.rodata);
        build/src/7C8850.c.o(.rodata);
        build/src/7C9000.c.o(.rodata);
        build/src/7C9C40.c.o(.rodata);
        build/src/7D03F0.c.o(.rodata);
        build/src/7D2C30.c.o(.rodata);
        build/src/7D9A10.c.o(.rodata);
        build/src/7E2850.c.o(.rodata);
        build/src/7F40B0.c.o(.rodata);
        build/src/7F8740.c.o(.rodata);
        . = ALIGN(., 16);
        main_code_RODATA_END = .;
        main_code_RODATA_SIZE = ABSOLUTE(main_code_RODATA_END - main_code_RODATA_START);
    }
    main_code_bss_VRAM = ADDR(.main_code_bss);
    .main_code_bss (NOLOAD) : SUBALIGN(16)
    {
        FILL(0x00000000);
        main_code_BSS_START = .;
        build/src/1340.c.o(.bss);
        build/src/22C0.c.o(.bss);
        build/src/2820.c.o(.bss);
        build/src/3CA0.c.o(.bss);
        build/src/42E0.c.o(.bss);
        build/src/5550.c.o(.bss);
        build/src/63A0.c.o(.bss);
        build/src/7210.c.o(.bss);
        build/src/7490.c.o(.bss);
        build/src/96E0.c.o(.bss);
        build/src/A1F0.c.o(.bss);
        build/src/ABC0.c.o(.bss);
        build/src/C3B0.c.o(.bss);
        build/src/CA60.c.o(.bss);
        build/src/CFD0.c.o(.bss);
        build/src/DC40.c.o(.bss);
        build/src/F490.c.o(.bss);
        build/src/11F60.c.o(.bss);
        build/src/12110.c.o(.bss);
        build/src/121E0.c.o(.bss);
        build/src/12460.c.o(.bss);
        build/src/14AE0.c.o(.bss);
        build/src/14E80.c.o(.bss);
        build/src/15100.c.o(.bss);
        build/src/15350.c.o(.bss);
        build/src/15F40.c.o(.bss);
        build/src/163B0.c.o(.bss);
        build/src/166E0.c.o(.bss);
        build/src/17C10.c.o(.bss);
        build/src/18080.c.o(.bss);
        build/src/18AD0.c.o(.bss);
        build/src/18D00.c.o(.bss);
        build/src/1ABE0.c.o(.bss);
        build/src/1C710.c.o(.bss);
        build/src/1E120.c.o(.bss);
        build/src/1E3E0.c.o(.bss);
        build/src/1EF70.c.o(.bss);
        build/src/1F260.c.o(.bss);
        build/src/1F7B0.c.o(.bss);
        build/src/1F970.c.o(.bss);
        build/src/20260.c.o(.bss);
        build/src/20990.c.o(.bss);
        build/src/20D10.c.o(.bss);
        build/src/20FE0.c.o(.bss);
        build/src/21010.c.o(.bss);
        build/src/21370.c.o(.bss);
        build/src/213E0.c.o(.bss);
        build/src/215A0.c.o(.bss);
        build/src/21610.c.o(.bss);
        build/src/216C0.c.o(.bss);
        build/src/219F0.c.o(.bss);
        build/src/21E20.c.o(.bss);
        build/src/21FD0.c.o(.bss);
        build/src/22540.c.o(.bss);
        build/src/23030.c.o(.bss);
        build/src/23160.c.o(.bss);
        build/src/231D0.c.o(.bss);
        build/src/23310.c.o(.bss);
        build/src/23450.c.o(.bss);
        build/src/23590.c.o(.bss);
        build/src/23610.c.o(.bss);
        build/src/236C0.c.o(.bss);
        build/src/23740.c.o(.bss);
        build/src/23850.c.o(.bss);
        build/src/238C0.c.o(.bss);
        build/src/23B40.c.o(.bss);
        build/src/23B70.c.o(.bss);
        build/src/23E30.c.o(.bss);
        build/src/23EE0.c.o(.bss);
        build/src/23F70.c.o(.bss);
        build/src/24240.c.o(.bss);
        build/src/24400.c.o(.bss);
        build/src/24540.c.o(.bss);
        build/src/245F0.c.o(.bss);
        build/src/24600.c.o(.bss);
        build/src/24F50.c.o(.bss);
        build/src/25040.c.o(.bss);
        build/src/250D0.c.o(.bss);
        build/src/25170.c.o(.bss);
        build/src/25200.c.o(.bss);
        build/src/25280.c.o(.bss);
        build/src/25420.c.o(.bss);
        build/src/25680.c.o(.bss);
        build/src/25730.c.o(.bss);
        build/src/25940.c.o(.bss);
        build/src/25960.c.o(.bss);
        build/src/25A10.c.o(.bss);
        build/src/262E0.c.o(.bss);
        build/src/26380.c.o(.bss);
        build/src/26420.c.o(.bss);
        build/src/26460.c.o(.bss);
        build/src/26580.c.o(.bss);
        build/src/268C0.c.o(.bss);
        build/src/26DF0.c.o(.bss);
        build/src/26E00.c.o(.bss);
        build/src/27160.c.o(.bss);
        build/src/27170.c.o(.bss);
        build/src/290F0.c.o(.bss);
        build/src/29290.c.o(.bss);
        build/src/29620.c.o(.bss);
        build/src/29F80.c.o(.bss);
        build/src/29F90.c.o(.bss);
        build/src/29FA0.c.o(.bss);
        build/src/2A2F0.c.o(.bss);
        build/src/2A380.c.o(.bss);
        build/src/2A3B0.c.o(.bss);
        build/src/2B540.c.o(.bss);
        build/src/2B5E0.c.o(.bss);
        build/src/2B5F0.c.o(.bss);
        build/src/2B6B0.c.o(.bss);
        build/src/2BF00.c.o(.bss);
        build/src/2CBA0.c.o(.bss);
        build/src/2CEA0.c.o(.bss);
        build/src/2DB00.c.o(.bss);
        build/src/2DC10.c.o(.bss);
        build/src/2DD60.c.o(.bss);
        build/src/2E1E0.c.o(.bss);
        build/src/2E310.c.o(.bss);
        build/src/2E410.c.o(.bss);
        build/src/2E420.c.o(.bss);
        build/src/2F690.c.o(.bss);
        build/src/302A0.c.o(.bss);
        build/src/30320.c.o(.bss);
        build/src/30330.c.o(.bss);
        build/src/30390.c.o(.bss);
        build/src/31990.c.o(.bss);
        build/src/40C00.c.o(.bss);
        build/src/12DB80.c.o(.bss);
        build/src/12EAA0.c.o(.bss);
        build/src/12F270.c.o(.bss);
        build/src/12FF20.c.o(.bss);
        build/src/13FB80.c.o(.bss);
        build/src/13FF80.c.o(.bss);
        build/src/140C00.c.o(.bss);
        build/src/1C0D50.c.o(.bss);
        build/src/345440.c.o(.bss);
        build/src/74EB40.c.o(.bss);
        build/src/74EBB0.c.o(.bss);
        build/src/74F340.c.o(.bss);
        build/src/74F520.c.o(.bss);
        build/src/750640.c.o(.bss);
        build/src/750D20.c.o(.bss);
        build/src/751140.c.o(.bss);
        build/src/7512D0.c.o(.bss);
        build/src/751480.c.o(.bss);
        build/src/751770.c.o(.bss);
        build/src/751990.c.o(.bss);
        build/src/751B60.c.o(.bss);
        build/src/751E30.c.o(.bss);
        build/src/752870.c.o(.bss);
        build/src/752890.c.o(.bss);
        build/src/752A50.c.o(.bss);
        build/src/753460.c.o(.bss);
        build/src/7568E0.c.o(.bss);
        build/src/756B20.c.o(.bss);
        build/src/756CE0.c.o(.bss);
        build/src/7571F0.c.o(.bss);
        build/src/7573B0.c.o(.bss);
        build/src/757480.c.o(.bss);
        build/src/7577F0.c.o(.bss);
        build/src/757A20.c.o(.bss);
        build/src/757AA0.c.o(.bss);
        build/src/759480.c.o(.bss);
        build/src/759D20.c.o(.bss);
        build/src/759F90.c.o(.bss);
        build/src/75A160.c.o(.bss);
        build/src/75A6D0.c.o(.bss);
        build/src/75A760.c.o(.bss);
        build/src/75A870.c.o(.bss);
        build/src/75B060.c.o(.bss);
        build/src/75B1D0.c.o(.bss);
        build/src/75B450.c.o(.bss);
        build/src/75B8E0.c.o(.bss);
        build/src/76DBA0.c.o(.bss);
        build/src/778840.c.o(.bss);
        build/src/780C30.c.o(.bss);
        build/src/784030.c.o(.bss);
        build/src/784C30.c.o(.bss);
        build/src/785FD0.c.o(.bss);
        build/src/786C30.c.o(.bss);
        build/src/788870.c.o(.bss);
        build/src/788940.c.o(.bss);
        build/src/78C500.c.o(.bss);
        build/src/78CC30.c.o(.bss);
        build/src/7BD440.c.o(.bss);
        build/src/7BD500.c.o(.bss);
        build/src/7BE410.c.o(.bss);
        build/src/7C0770.c.o(.bss);
        build/src/7C0C00.c.o(.bss);
        build/src/7C0C30.c.o(.bss);
        build/src/7C0C80.c.o(.bss);
        build/src/7C1040.c.o(.bss);
        build/src/7C1090.c.o(.bss);
        build/src/7C2C00.c.o(.bss);
        build/src/7C3030.c.o(.bss);
        build/src/7C3C50.c.o(.bss);
        build/src/7C6C30.c.o(.bss);
        build/src/7C8850.c.o(.bss);
        build/src/7C9000.c.o(.bss);
        build/src/7C9C40.c.o(.bss);
        build/src/7D03F0.c.o(.bss);
        build/src/7D2C30.c.o(.bss);
        build/src/7D9A10.c.o(.bss);
        build/src/7E2850.c.o(.bss);
        build/src/7F40B0.c.o(.bss);
        build/src/7F8740.c.o(.bss);
        . = ALIGN(., 16);
        main_code_BSS_END = .;
        main_code_BSS_SIZE = ABSOLUTE(main_code_BSS_END - main_code_BSS_START);
    }
    __romPos += SIZEOF(.main_code);
    __romPos = ALIGN(__romPos, 16);
    . = ALIGN(., 16);
    main_code_ROM_END = __romPos;
    main_code_VRAM_END = .;

    /DISCARD/ :
    {
        *(*);
    }
}
